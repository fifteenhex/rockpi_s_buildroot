## br2rockpis/Config.in
```kconfig
source "$BR2_EXTERNAL_ROCKPIS_PATH/package/rkbin/Config.in"
source "$BR2_EXTERNAL_ROCKPIS_PATH/package/rkdeveloptool/Config.in"
```

## br2rockpis/board/rockpis/kernel.its
```
/dts-v1/;

/ {
	description = "Rock Pi S";
	#address-cells = <1>;

	images {
		kernel@0 {
			data = /incbin/("../../images/Image");
			type = "kernel";
			arch = "arm64";
			os = "linux";
			compression = "none";
			load = <0x280000>;
                        entry = <0x280000>;
			hash@1 {
				algo = "crc32";
			};
			hash@2 {
				algo = "sha1";
			};
		};
		fdt@0 {
			data = /incbin/("../../images/rk3308-rock-pi-s.dtb");
			type = "flat_dt";
			arch = "arm64";
			compression = "none";
			load = <0x01f00000>;
			hash@1 {
				algo = "crc32";
			};
			hash@2 {
				algo = "sha1";
			};
		};
	};

	configurations {
		default = "normal";
		normal {
			kernel = "kernel@0";
			fdt = "fdt@0";
		};
	};
};
```

## br2rockpis/configs/rockpis_defconfig
```kconfig
BR2_aarch64=y
BR2_cortex_a35=y
BR2_CCACHE=y
BR2_TOOLCHAIN_BUILDROOT_GLIBC=y
BR2_KERNEL_HEADERS_4_4=y
BR2_BINUTILS_VERSION_2_33_X=y
BR2_GCC_VERSION_7_X=y
# BR2_TARGET_ENABLE_ROOT_LOGIN is not set
BR2_SYSTEM_DHCP="eth0"
BR2_ROOTFS_USERS_TABLES="$(BR2_EXTERNAL_ROCKPIS_PATH)/board/rockpis/users"
BR2_ROOTFS_POST_IMAGE_SCRIPT="$(BR2_EXTERNAL_ROCKPIS_PATH)/board/rockpis/postfs.sh"
BR2_LINUX_KERNEL=y
BR2_LINUX_KERNEL_CUSTOM_GIT=y
BR2_LINUX_KERNEL_CUSTOM_REPO_URL="https://github.com/radxa/kernel.git"
BR2_LINUX_KERNEL_CUSTOM_REPO_VERSION="stable-4.4-rockpis"
BR2_LINUX_KERNEL_DEFCONFIG="rk3308_linux"
BR2_LINUX_KERNEL_XZ=y
BR2_LINUX_KERNEL_DTS_SUPPORT=y
BR2_LINUX_KERNEL_INTREE_DTS_NAME="rockchip/rk3308-rock-pi-s"
BR2_LINUX_KERNEL_DTB_OVERLAY_SUPPORT=y
BR2_PACKAGE_BUSYBOX_WATCHDOG=y
BR2_PACKAGE_DROPBEAR=y
BR2_PACKAGE_SUDO=y
BR2_TARGET_ROOTFS_CPIO=y
BR2_TARGET_ROOTFS_CPIO_XZ=y
BR2_TARGET_ROOTFS_SQUASHFS=y
BR2_TARGET_ROOTFS_SQUASHFS4_XZ=y
BR2_TARGET_UBOOT=y
BR2_TARGET_UBOOT_BUILD_SYSTEM_KCONFIG=y
BR2_TARGET_UBOOT_CUSTOM_GIT=y
BR2_TARGET_UBOOT_CUSTOM_REPO_URL="https://github.com/radxa/u-boot.git"
BR2_TARGET_UBOOT_CUSTOM_REPO_VERSION="stable-4.4-rockpis"
BR2_TARGET_UBOOT_BOARD_DEFCONFIG="rock-pi-s-rk3308"
BR2_TARGET_UBOOT_CONFIG_FRAGMENT_FILES="$(BR2_EXTERNAL_ROCKPIS_PATH)/board/rockpis/uboot_fragments/env_in_fat.fragment"
BR2_TARGET_UBOOT_NEEDS_DTC=y
# BR2_TARGET_UBOOT_FORMAT_BIN is not set
BR2_TARGET_UBOOT_FORMAT_DTB_BIN=y
BR2_PACKAGE_HOST_DOSFSTOOLS=y
BR2_PACKAGE_HOST_GENIMAGE=y
BR2_PACKAGE_HOST_MTOOLS=y
BR2_PACKAGE_HOST_UBOOT_TOOLS=y
BR2_PACKAGE_HOST_UBOOT_TOOLS_FIT_SUPPORT=y
BR2_PACKAGE_HOST_UBOOT_TOOLS_FIT_SIGNATURE_SUPPORT=y
BR2_PACKAGE_RKBIN=y
BR2_PACKAGE_HOST_RKDEVELOPTOOL=y
BR2_PACKAGE_AUTOSSHKEY=y
BR2_PACKAGE_AUTOSSHKEY_USERS="weewee"
BR2_PACKAGE_AUTOSSHKEY_SUDOUSERS="weewee"
```

## br2rockpis/package/rkdeveloptool/Config.in
```kconfig
config BR2_PACKAGE_HOST_RKDEVELOPTOOL
        bool "rkdeveloptool"
	select BR2_PACKAGE_HOST_LIBUSB
        help
          Rockchip developtool
```
