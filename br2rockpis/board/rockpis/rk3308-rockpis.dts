// SPDX-License-Identifier: (GPL-2.0+ OR MIT)
/*
 * Copyright (c) 2020 Daniel Palmer
 *
 */

/dts-v1/;
#include "rk3308.dtsi"

/ {
	model = "Rockchip RK3308 Rock Pi S";
	compatible = "rockchip,rk3308-rockpis", "rockchip,rk3308";

	chosen {
		stdout-path = "serial0:1500000n8";
	};
};

&uart0 {
	pinctrl-names = "default";
	pinctrl-0 = <&uart0_xfer>;
	status = "okay";
};
